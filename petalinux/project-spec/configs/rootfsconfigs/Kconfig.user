## petalinux/project-spec/configs/rootfsconfigs/Kconfig.user
```kconfig
menu "user packages " 
config gpio-demo  
	 bool "gpio-demo"
	 help
	
config nano  
	 bool "nano"
	 help
	
config peekpoke  
	 bool "peekpoke"
	 help
	
endmenu
```
